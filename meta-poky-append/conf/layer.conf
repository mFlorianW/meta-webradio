## meta-poky-append/conf/layer.conf
```bitbake
# We have a conf and classes directory, add to BBPATH
BBPATH .= ":${LAYERDIR}"

# We have recipes-* directories, add to BBFILES
BBFILES += "${LAYERDIR}/recipes-*/*/*.bb \
	${LAYERDIR}/recipes-*/*/*.bbappend"

BBFILE_COLLECTIONS += "poky-append"
BBFILE_PATTERN_poky-append = "^${LAYERDIR}/"
BBFILE_PRIORITY_poky-append = "6"
```

## meta-webradio/conf/layer.conf
```bitbake
# We have a conf and classes directory, add to BBPATH
BBPATH .= ":${LAYERDIR}"

# We have recipes-* directories, add to BBFILES
BBFILES += "${LAYERDIR}/recipes-*/*/*.bb \
	${LAYERDIR}/recipes-*/*/*.bbappend"

BBFILE_COLLECTIONS += "webradio"
BBFILE_PATTERN_webradio = "^${LAYERDIR}/"
BBFILE_PRIORITY_webradio = "6"
```
